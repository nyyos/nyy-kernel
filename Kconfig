## Kconfig
```kconfig
mainmenu "Nyy Kernel configuration"

menu "Debug"

config DISABLE_ASSERTS
  bool "Disable asserts in code"
  default n

config UBSAN
  bool "Enable UBSAN"
  default y

config STACKGUARD
  bool "Enable stack protector"
  default y

choice
  prompt "Log level"
  default LOG_LEVEL_INFO

config LOG_LEVEL_SPAM
      bool "Enable spam messages (annoyingly verbose messages)"

config LOG_LEVEL_DEBUG
      bool "Enable debug messages"

config LOG_LEVEL_TRACE
      bool "Enable trace messages"

config LOG_LEVEL_INFO
      bool "Enable info messages"

config LOG_LEVEL_WARN
      bool "Enable warn messages"

config LOG_LEVEL_ERROR
      bool "Enable error messages"

endchoice

endmenu

source "$(ROOT)/kernel/Kconfig"
```

## kernel/Kconfig
```kconfig
config SMP 
    bool "Enable SMP"
    default y

source "$(ROOT)/kernel/vm/Kconfig"
source "$(ROOT)/kernel/platform/$(ARCH)/Kconfig"
```

## kernel/platform/amd64/Kconfig
```kconfig
menu "platform options"
	config SERIAL
		bool "Enable serial output"
		default y

	source "$(ROOT)/kernel/platform/limine-generic/Kconfig"
endmenu
```

## kernel/platform/limine-generic/Kconfig
```kconfig
# this file shall be included by every limine target

config EARLY_FRAMEBUFFER
	bool "Enable early framebuffer output"
	default y
```

## kernel/vm/Kconfig
```kconfig
menu "Memory subsystem"

config HHDM_HUGEPAGES
  bool "Try mapping HHDM with hugepages"
  default n 

endmenu
```
